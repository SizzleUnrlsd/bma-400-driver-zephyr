## boards/arm/linkit_core_nrf52840/Kconfig.linkit_core_nrf52840
```kconfig
# Linkit CORE nRF52840 Express board configuration

# Copyright (c) 2020 Tobias Svehagen
# SPDX-License-Identifier: Apache-2.0

config BOARD_LINKIT_CORE_NRF52840
	select SOC_NRF52840_QIAA
```

## boards/arm/linkit_core_nrf52840/board.yml
```yaml
board:
  name: linkit_core_nrf52840
  vendor: arribada
  socs:
  - name: nrf52840
```

## boards/arm/linkit_core_nrf52840/linkit_core_nrf52840_defconfig
```kconfig
# # # SPDX-License-Identifier: Apache-2.0

# # # Enable MPU
# # CONFIG_ARM_MPU=y

# # # enable GPIO
# # CONFIG_GPIO=y

# # # enable uart driver
# # CONFIG_SERIAL=y

# # # enable console
# # CONFIG_CONSOLE=y
# # CONFIG_UART_CONSOLE=y


# # # Manage External flash:
# # CONFIG_FLASH=y
# # CONFIG_FLASH_PAGE_LAYOUT=y
# # CONFIG_FLASH_MAP=y
# # CONFIG_MPU_ALLOW_FLASH_WRITE=y
# # CONFIG_NORDIC_QSPI_NOR=y

# # # Enable SPI dedicated to Artic
# # CONFIG_SPI=y

# # # Enable I2C for sensors
# # CONFIG_I2C=y

# # SPDX-License-Identifier: Apache-2.0

# # Enable MPU
# CONFIG_ARM_MPU=y

# # enable GPIO
# CONFIG_GPIO=y

# # enable uart driver
# CONFIG_SERIAL=y

# # enable console
# CONFIG_CONSOLE=y
# CONFIG_UART_CONSOLE=y


# # Manage External flash:
# CONFIG_FLASH=y
# CONFIG_FLASH_PAGE_LAYOUT=y
# CONFIG_FLASH_MAP=y
# CONFIG_MPU_ALLOW_FLASH_WRITE=y
# CONFIG_NORDIC_QSPI_NOR=y

# # Enable SPI dedicated to Artic
# CONFIG_SPI=n

# # Enable I2C for sensors
# CONFIG_I2C=y
# CONFIG_SENSOR=y
# CONFIG_SENSOR_ASYNC_API=y
# #CONFIG_DT_HAS_BOSCH_BMA4XX_ENABLED=y
# # CONFIG_BMA4XX=y

# CONFIG_CBPRINTF_FP_SUPPORT=y
# CONFIG_STDOUT_CONSOLE=y
# CONFIG_SERIAL=y
# CONFIG_BMA4XX=y
# CONFIG_MAIN_STACK_SIZE=2048
# # CONFIG_BMA400=y
# # CONFIG_BMA400_TRIGGER_GLOBAL_THREAD=y


# SPDX-License-Identifier: Apache-2.0

# Enable MPU
CONFIG_ARM_MPU=y

# enable GPIO
CONFIG_GPIO=y

# enable uart driver
CONFIG_SERIAL=y

# enable console
CONFIG_CONSOLE=y
CONFIG_UART_CONSOLE=y


# Manage External flash:
CONFIG_FLASH=y
CONFIG_FLASH_PAGE_LAYOUT=y
CONFIG_FLASH_MAP=y
CONFIG_MPU_ALLOW_FLASH_WRITE=y
CONFIG_NORDIC_QSPI_NOR=y

# Enable SPI dedicated to Artic
CONFIG_SPI=n

# Enable I2C for sensors
CONFIG_I2C=y
CONFIG_SENSOR=y
CONFIG_SENSOR_ASYNC_API=y
#CONFIG_DT_HAS_BOSCH_BMA4XX_ENABLED=y
CONFIG_BMA4XX=y
CONFIG_BMA400=y

CONFIG_CBPRINTF_FP_SUPPORT=y
CONFIG_STDOUT_CONSOLE=y
CONFIG_SERIAL=y
# CONFIG_BMA4XX=y
CONFIG_MAIN_STACK_SIZE=2048
# CONFIG_BMA400=y
# CONFIG_BMA4XX=y
# CONFIG_BMA400_TRIGGER_GLOBAL_THREAD=y
CONFIG_UART_INTERRUPT_DRIVEN=y
```

## drivers/bma4xx/Kconfig
```kconfig
menuconfig BMA4XX
    bool "Enable BMA4XX"
    depends on CONFIG_UART_INTERRUPT_DRIVEN
    default y
    select I2C
    help
	    BMA 4XX sensor from I2C

config BMA_400
    bool "Enable bma 400 peripheral"
    depends on UART_INTERRUPT_DRIVEN

if BMA_400
    module = BMA_400
    module-str = bma 400
    source "subsys/logging/Kconfig.template.log_config"
endif
```

## dts/bindings/bma4xx/arribada,bma4xx.yml
```yaml
# description: |
#   BMA 400 driver

# compatible: bosch,bma4xx

# include: [sensor-device.yaml, i2c-device.yaml]
```

## lib/Kconfig
```kconfig
# Copyright (c) 2021 Legrand North America, LLC.
# SPDX-License-Identifier: Apache-2.0

menu "Libraries"

rsource "custom_lib/Kconfig"

endmenu

# menu "Custom libraries"

# rsource "custom/Kconfig"

# endmenu
```
